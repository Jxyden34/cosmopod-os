## meta-cosmopod/conf/distro/cosmopod.conf
```bitbake
require conf/distro/poky.conf

DISTRO = "cosmopod"
DISTROOVERRIDES = "poky:cosmopod"
DISTRO_NAME = "Cosmopod OS"
DISTRO_VERSION = "${COSMOPOD_VERSION}"
DISTRO_CODENAME = "launchpad"
SDK_VENDOR = "-cosmopod"

DISTRO_FEATURES:append = " systemd pam polkit wayland opengl usrmerge ipv6 wifi bluetooth"
DISTRO_FEATURES:remove = " x11 sysvinit"

VIRTUAL-RUNTIME_init_manager = "systemd"
VIRTUAL-RUNTIME_initscripts = "systemd-compat-units"
VIRTUAL-RUNTIME_login_manager = "shadow-base"

SYSTEMD_DEFAULT_TARGET = "graphical.target"
PREFERRED_PROVIDER_virtual/ssh = "openssh"

# Rootfs changes are released as tested A/B artifacts, not live package feeds.
EXTRA_IMAGE_FEATURES = ""
```

## meta-cosmopod/conf/layer.conf
```bitbake
BBPATH .= ":${LAYERDIR}"
BBFILES += "${LAYERDIR}/recipes-*/*/*.bb ${LAYERDIR}/recipes-*/*/*.bbappend"

BBFILE_COLLECTIONS += "cosmopod"
BBFILE_PATTERN_cosmopod = "^${LAYERDIR}/"
BBFILE_PRIORITY_cosmopod = "20"

LAYERSERIES_COMPAT_cosmopod = "wrynose"
LAYERDEPENDS_cosmopod = "core raspberrypi mender openembedded-layer meta-python networking-layer filesystems-layer multimedia-layer"

WKS_FILE_PATH:append := ":${LAYERDIR}/wic"
```

## meta-cosmopod/wic/cosmopod-vm.wks
```
# BIOS+UEFI ISO comes from image-live. This EFI disk is the persistent VM form.
part /boot --source bootimg-efi --sourceparams="loader=grub-efi" --ondisk sda --label boot --use-label --active --align 1024
part / --source rootfs --ondisk sda --fstype=ext4 --label platform --align 1024 --use-uuid
part /data --ondisk sda --fstype=ext4 --label cosmopod-data --use-label --size 1024 --align 1024 --fsoptions="defaults,nofail,x-systemd.device-timeout=5s"
part swap --ondisk sda --size 256 --label swap1 --use-label --fstype=swap

bootloader --ptable gpt --timeout=5 --append="rw rootfstype=ext4 console=ttyS0,115200 console=tty0"
```
